#include "peripherals/Display.h"

#include "hardware/gpio.h"
#include "pico/time.h"

#include <array>
#include <numeric>
#include <string>

namespace Divacon::Peripherals {

namespace {

const std::array<uint8_t, 1154> menu_screen_sub = {
    0x42, 0x4d, 0x82, 0x04, 0x00, 0x00, 0x00, 0x00, 0x00, 0x00, 0x82, 0x00, 0x00, 0x00, 0x6c, 0x00, 0x00, 0x00, 0x80,
    0x00, 0x00, 0x00, 0x40, 0x00, 0x00, 0x00, 0x01, 0x00, 0x01, 0x00, 0x00, 0x00, 0x00, 0x00, 0x00, 0x04, 0x00, 0x00,
    0x23, 0x2e, 0x00, 0x00, 0x23, 0x2e, 0x00, 0x00, 0x02, 0x00, 0x00, 0x00, 0x02, 0x00, 0x00, 0x00, 0x00, 0x00, 0xff,
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    0xff, 0xff, 0xff, 0xff, 0xff, 0xff, 0xff, 0xff, 0xff, 0xff, 0xff, 0xff, 0xff, 0xff};

const std::array<uint8_t, 1154> menu_screen_top = {
    0x42, 0x4d, 0x82, 0x04, 0x00, 0x00, 0x00, 0x00, 0x00, 0x00, 0x82, 0x00, 0x00, 0x00, 0x6c, 0x00, 0x00, 0x00, 0x80,
    0x00, 0x00, 0x00, 0x40, 0x00, 0x00, 0x00, 0x01, 0x00, 0x01, 0x00, 0x00, 0x00, 0x00, 0x00, 0x00, 0x04, 0x00, 0x00,
    0x23, 0x2e, 0x00, 0x00, 0x23, 0x2e, 0x00, 0x00, 0x02, 0x00, 0x00, 0x00, 0x02, 0x00, 0x00, 0x00, 0x00, 0x00, 0xff,
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    0xff, 0xff, 0xff, 0xff, 0xff, 0xff, 0xff, 0xff, 0xff, 0xff, 0xff, 0xff, 0xff, 0xff};

std::string modeToString(usb_mode_t mode) {
    switch (mode) {
    case USB_MODE_SWITCH_DIVACON:
        return "Switch Diva";
    case USB_MODE_SWITCH_HORIPAD:
        return "Switch Horipad";
    case USB_MODE_DUALSHOCK3:
        return "Dualshock 3";
    case USB_MODE_PS4_DIVACON:
        return "PS4 Diva";
    case USB_MODE_PS4_COMPAT:
        return "PS4 Compat";
    case USB_MODE_DUALSHOCK4:
        return "Dualshock 4";
    case USB_MODE_XBOX360:
        return "Xbox 360";
    case USB_MODE_PDLOADER:
        return "PDL Arcade";
    case USB_MODE_KEYBOARD:
        return "Keyboard";
    case USB_MODE_MIDI:
        return "MIDI";
    case USB_MODE_DEBUG:
        return "Debug";
    }
    return "?";
}

} // namespace

void Display::BpmCounter::Buffer::insert(uint16_t value) {
    if (m_buffer.size() >= m_size_limit) {
        m_buffer.pop_back();
    }
    m_buffer.push_front(value);
}

uint16_t Display::BpmCounter::Buffer::getAvarage() const {
    if (!m_buffer.empty()) {
        return std::accumulate(m_buffer.begin(), m_buffer.end(), 0) / m_buffer.size();
    }
    return 0;
}

void Display::BpmCounter::update(const Utils::InputState::Buttons &buttons) {
    // Somewhat ugly gimmick to calculate the how often the face buttons
    // are pressed per minute.
    //
    // It records the average time between the last 'WINDOW_SIZE' button
    // presses for calculation. To avoid spikes caused by simultaneous
    // button presses, all presses within 'DOUBLE_HIT_TIMEOUT_MS' are counted
    // as a single press.
    //
    // Counter resets after 'm_timeout_ms'.
    const uint32_t now = to_ms_since_boot(get_absolute_time());
    const uint32_t interval = now - m_prev_press_time;

    if (interval > m_timeout_ms) {
        m_buffer.clear();
        m_current_bpm = 0;
        m_prev_press_time = 0;
    }

    if ((interval > DOUBLE_HIT_TIMEOUT_MS) &&
        ((buttons.north && !m_prev_buttons.north) || (buttons.east && !m_prev_buttons.east) ||
         (buttons.south && !m_prev_buttons.south) || (buttons.west && !m_prev_buttons.west))) {

        if (m_prev_press_time != 0) {
            m_buffer.insert(interval);
            m_current_bpm = 60000 / m_buffer.getAvarage();
        }

        m_prev_press_time = now;
    }

    m_prev_buttons = buttons;
}

Display::Display(const Config &config) : m_config(config) {
    i2c_init(m_config.i2c_block, m_config.i2c_speed_hz);
    gpio_set_function(m_config.sda_pin, GPIO_FUNC_I2C);
    gpio_set_function(m_config.scl_pin, GPIO_FUNC_I2C);
    gpio_pull_up(m_config.sda_pin);
    gpio_pull_up(m_config.scl_pin);

    m_display.external_vcc = false;
    ssd1306_init(&m_display, 128, 64, m_config.i2c_address, m_config.i2c_block);
    ssd1306_clear(&m_display);
}

void Display::setTouched(uint32_t touched) { m_touched = touched; }
void Display::setButtons(const Utils::InputState::Buttons &buttons) { m_bpm_counter.update(buttons); }
void Display::setUsbMode(usb_mode_t mode) { m_usb_mode = mode; };
void Display::setPlayerId(uint8_t player_id) { m_player_id = player_id; };
void Display::setAuthBusyState(bool busy) { m_auth_busy = busy; };

void Display::setMenuState(const Utils::Menu::State &menu_state) { m_menu_state = menu_state; }

void Display::showIdle() { m_state = State::Idle; }
void Display::showMenu() { m_state = State::Menu; }

void Display::drawIdleScreen() {
    // Header
    const std::string mode_string = modeToString(m_usb_mode) + " mode";
    ssd1306_draw_string(&m_display, 0, 0, 1, mode_string.c_str());
    ssd1306_draw_line(&m_display, 0, 10, 128, 10);

    // BPM
    auto bpm_str = std::to_string(m_bpm_counter.getBpm()) + " bpm";
    ssd1306_draw_string(&m_display, (127 - (bpm_str.length() * 12)) / 2, 20, 2, bpm_str.c_str());

    // Player "LEDs"
    if (m_player_id != 0) {
        for (uint8_t i = 0; i < 4; ++i) {
            if ((m_player_id & (1 << i)) != 0) {
                ssd1306_draw_square(&m_display, ((127) - ((4 - i) * 6)) - 1, 2, 4, 4);
            } else {
                ssd1306_draw_square(&m_display, (127) - ((4 - i) * 6), 3, 2, 2);
            }
        }
    }

    // Slider state
    ssd1306_draw_line(&m_display, 0, 46, 128, 46);
    for (int i = 0; i < 32; ++i) {
        if ((m_touched & (1 << i)) != 0) {
            ssd1306_draw_square(&m_display, (127 - 3) - (i * 4), 46, 3, 8);
        }
    }

    // Menu hint
    ssd1306_draw_line(&m_display, 0, 54, 128, 54);
    if (m_auth_busy) {
        ssd1306_draw_string(&m_display, 0, 56, 1, "PS4 Auth busy...  ");
    } else {
        ssd1306_draw_string(&m_display, 0, 56, 1, "Hold STA+SEL for Menu");
    }
}

void Display::drawMenuScreen() {
    auto descriptor_it = Utils::Menu::descriptors.find(m_menu_state.page);
    if (descriptor_it == Utils::Menu::descriptors.end()) {
        return;
    }

    // Background
    switch (descriptor_it->second.type) {
    case Utils::Menu::Descriptor::Type::Menu:
        if (m_menu_state.page == Utils::Menu::Page::Main) {
            ssd1306_bmp_show_image(&m_display, menu_screen_top.data(), menu_screen_top.size());
        } else {
            ssd1306_bmp_show_image(&m_display, menu_screen_sub.data(), menu_screen_sub.size());
        }
        break;
    case Utils::Menu::Descriptor::Type::Selection:
    case Utils::Menu::Descriptor::Type::Value:
    case Utils::Menu::Descriptor::Type::Toggle:
        ssd1306_bmp_show_image(&m_display, menu_screen_sub.data(), menu_screen_sub.size());
        break;
    case Utils::Menu::Descriptor::Type::RebootInfo:
        break;
    }

    // Heading
    ssd1306_draw_string(&m_display, 0, 0, 1, descriptor_it->second.name.c_str());

    // Current Selection
    std::string selection;
    switch (descriptor_it->second.type) {
    case Utils::Menu::Descriptor::Type::Menu:
    case Utils::Menu::Descriptor::Type::Selection:
    case Utils::Menu::Descriptor::Type::RebootInfo:
        selection = descriptor_it->second.items.at(m_menu_state.selected_value).first;
        break;
    case Utils::Menu::Descriptor::Type::Value:
        selection = std::to_string(m_menu_state.selected_value);
        break;
    case Utils::Menu::Descriptor::Type::Toggle:
        selection = m_menu_state.selected_value == 0 ? "Off" : "On";
        break;
    }
    ssd1306_draw_string(&m_display, (127 - (selection.length() * 12)) / 2, 15, 2, selection.c_str());

    // Breadcrumbs
    switch (descriptor_it->second.type) {
    case Utils::Menu::Descriptor::Type::Menu:
    case Utils::Menu::Descriptor::Type::Selection: {
        auto selection_count = descriptor_it->second.items.size();
        for (size_t i = 0; i < selection_count; ++i) {
            if (i == m_menu_state.selected_value) {
                ssd1306_draw_square(&m_display, ((127) - ((selection_count - i) * 6)) - 1, 2, 4, 4);
            } else {
                ssd1306_draw_square(&m_display, (127) - ((selection_count - i) * 6), 3, 2, 2);
            }
        }
    } break;
    case Utils::Menu::Descriptor::Type::RebootInfo:
    case Utils::Menu::Descriptor::Type::Value:
    case Utils::Menu::Descriptor::Type::Toggle:
        break;
    }
}

void Display::update(bool force) {
    static const uint32_t interval_ms = 17; // Limit to ~60fps

    if (!force && (to_ms_since_boot(get_absolute_time()) - m_next_frame_time < interval_ms)) {
        return;
    }
    m_next_frame_time += interval_ms;

    ssd1306_clear(&m_display);

    switch (m_state) {
    case State::Idle:
        drawIdleScreen();
        break;
    case State::Menu:
        drawMenuScreen();
        break;
    }

    ssd1306_show(&m_display);
};

} // namespace Divacon::Peripherals