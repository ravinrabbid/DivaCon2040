#include "peripherals/Display.h"

#include "hardware/gpio.h"
#include "pico/time.h"

#include <array>
#include <list>
#include <numeric>
#include <string>

namespace Divacon::Peripherals {

static const std::array<uint8_t, 1154> menu_screen_sub = {
    0x42, 0x4d, 0x82, 0x04, 0x00, 0x00, 0x00, 0x00, 0x00, 0x00, 0x82, 0x00, 0x00, 0x00, 0x6c, 0x00, 0x00, 0x00, 0x80,
    0x00, 0x00, 0x00, 0x40, 0x00, 0x00, 0x00, 0x01, 0x00, 0x01, 0x00, 0x00, 0x00, 0x00, 0x00, 0x00, 0x04, 0x00, 0x00,
    0x23, 0x2e, 0x00, 0x00, 0x23, 0x2e, 0x00, 0x00, 0x02, 0x00, 0x00, 0x00, 0x02, 0x00, 0x00, 0x00, 0x00, 0x00, 0xff,
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    0xff, 0xff, 0xff, 0xff, 0xff, 0xff, 0xff, 0xff, 0xff, 0xff, 0xff, 0xff, 0xff, 0xff};

static const std::array<uint8_t, 1154> menu_screen_top = {
    0x42, 0x4d, 0x82, 0x04, 0x00, 0x00, 0x00, 0x00, 0x00, 0x00, 0x82, 0x00, 0x00, 0x00, 0x6c, 0x00, 0x00, 0x00, 0x80,
    0x00, 0x00, 0x00, 0x40, 0x00, 0x00, 0x00, 0x01, 0x00, 0x01, 0x00, 0x00, 0x00, 0x00, 0x00, 0x00, 0x04, 0x00, 0x00,
    0x23, 0x2e, 0x00, 0x00, 0x23, 0x2e, 0x00, 0x00, 0x02, 0x00, 0x00, 0x00, 0x02, 0x00, 0x00, 0x00, 0x00, 0x00, 0xff,
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    0xff, 0xff, 0xff, 0xff, 0xff, 0xff, 0xff, 0xff, 0xff, 0xff, 0xff, 0xff, 0xff, 0xff};

Display::Display(const Config &config)
    : m_config(config), m_state(State::Idle), m_touched(0), m_buttons({}), m_usb_mode(USB_MODE_DEBUG), m_player_id(0),
      m_menu_state({Utils::Menu::Page::Main, 0}) {

    i2c_init(m_config.i2c_block, m_config.i2c_speed_hz);
    gpio_set_function(m_config.sda_pin, GPIO_FUNC_I2C);
    gpio_set_function(m_config.scl_pin, GPIO_FUNC_I2C);
    gpio_pull_up(m_config.sda_pin);
    gpio_pull_up(m_config.scl_pin);

    m_display.external_vcc = false;
    ssd1306_init(&m_display, 128, 64, m_config.i2c_address, m_config.i2c_block);
    ssd1306_clear(&m_display);
}

void Display::setTouched(uint32_t touched) { m_touched = touched; }
void Display::setButtons(const Utils::InputState::Buttons &buttons) { m_buttons = buttons; }
void Display::setUsbMode(usb_mode_t mode) { m_usb_mode = mode; };
void Display::setPlayerId(uint8_t player_id) { m_player_id = player_id; };

void Display::setMenuState(const Utils::Menu::State &menu_state) { m_menu_state = menu_state; }

void Display::showIdle() { m_state = State::Idle; }
void Display::showMenu() { m_state = State::Menu; }

static std::string modeToString(usb_mode_t mode) {
    switch (mode) {
    case USB_MODE_SWITCH_DIVACON:
        return "Switch Diva";
    case USB_MODE_SWITCH_HORIPAD:
        return "Switch Horipad";
    case USB_MODE_DUALSHOCK3:
        return "Dualshock 3";
    case USB_MODE_PS4_DIVACON:
        return "PS4 Diva";
    case USB_MODE_DUALSHOCK4:
        return "Dualshock 4";
    case USB_MODE_XBOX360:
        return "Xbox 360";
    case USB_MODE_PDLOADER:
        return "PDL Arcade";
    case USB_MODE_KEYBOARD:
        return "Keyboard";
    case USB_MODE_MIDI:
        return "MIDI";
    case USB_MODE_DEBUG:
        return "Debug";
    }
    return "?";
}

static uint16_t calculateBpm(const Utils::InputState::Buttons &buttons) {
    // Somewhat ugly gimmick to calculate the how often the face buttons
    // are pressed per minute.
    //
    // It records the average time between the last 'window_size' button
    // presses for calculation. To avoid spikes caused by simultaneous
    // button presses, all presses within 'double_hit_window' are counted
    // as a single press.
    //
    // Counter resets after 'reset_after'.

    static const size_t window_size = 20;
    static const uint32_t double_hit_window = 50;
    static const uint32_t reset_after = 2000;

    static Utils::InputState::Buttons prev_buttons = {};
    static uint32_t prev_press = 0;
    static uint16_t current_bpm = 0;

    struct StatBuffer {
      private:
        std::list<uint16_t> m_buf;
        size_t m_max_size;

      public:
        StatBuffer(size_t max_size) : m_max_size(max_size) {}

        void clear() { m_buf.clear(); };

        void insert(uint16_t val) {
            if (m_buf.size() >= m_max_size) {
                m_buf.pop_back();
            }
            m_buf.push_front(val);
        };

        uint16_t avg() {
            if (m_buf.size() > 0) {
                return std::accumulate(m_buf.begin(), m_buf.end(), 0) / m_buf.size();
            }
            return 0;
        }
    };
    static StatBuffer stat_buffer(window_size);

    uint32_t now = to_ms_since_boot(get_absolute_time());
    uint32_t interval = now - prev_press;

    if (interval > reset_after) {
        stat_buffer.clear();
        current_bpm = 0;
        prev_press = 0;
    }

    if ((interval > double_hit_window) &&
        ((buttons.north && !prev_buttons.north) || (buttons.east && !prev_buttons.east) ||
         (buttons.south && !prev_buttons.south) || (buttons.west && !prev_buttons.west))) {

        if (prev_press != 0) {
            stat_buffer.insert(interval);
            current_bpm = 60000 / stat_buffer.avg();
        }

        prev_press = now;
    }

    prev_buttons = buttons;

    return current_bpm;
}

void Display::drawIdleScreen() {
    // Header
    std::string mode_string = modeToString(m_usb_mode) + " mode";
    ssd1306_draw_string(&m_display, 0, 0, 1, mode_string.c_str());
    ssd1306_draw_line(&m_display, 0, 10, 128, 10);

    // BPM
    auto bpm_str = std::to_string(calculateBpm(m_buttons)) + " bpm";
    ssd1306_draw_string(&m_display, (127 - (bpm_str.length() * 12)) / 2, 20, 2, bpm_str.c_str());

    // Player "LEDs"
    if (m_player_id != 0) {
        for (uint8_t i = 0; i < 4; ++i) {
            if (m_player_id & (1 << i)) {
                ssd1306_draw_square(&m_display, ((127) - ((4 - i) * 6)) - 1, 2, 4, 4);
            } else {
                ssd1306_draw_square(&m_display, (127) - ((4 - i) * 6), 3, 2, 2);
            }
        }
    }

    // Slider state
    ssd1306_draw_line(&m_display, 0, 46, 128, 46);
    for (int i = 0; i < 32; ++i) {
        if (m_touched & (1 << i)) {
            ssd1306_draw_square(&m_display, (127 - 3) - (i * 4), 46, 3, 8);
        }
    }

    // Menu hint
    ssd1306_draw_line(&m_display, 0, 54, 128, 54);
    ssd1306_draw_string(&m_display, 0, 56, 1, "Hold STA+SEL for Menu");
}

void Display::drawMenuScreen() {
    auto descriptor_it = Utils::Menu::descriptors.find(m_menu_state.page);
    if (descriptor_it == Utils::Menu::descriptors.end()) {
        return;
    }

    // Background
    switch (descriptor_it->second.type) {
    case Utils::Menu::Descriptor::Type::Root:
        ssd1306_bmp_show_image(&m_display, menu_screen_top.data(), menu_screen_top.size());
        break;
    case Utils::Menu::Descriptor::Type::Selection:
    case Utils::Menu::Descriptor::Type::Value:
        ssd1306_bmp_show_image(&m_display, menu_screen_sub.data(), menu_screen_sub.size());
        break;
    case Utils::Menu::Descriptor::Type::RebootInfo:
        break;
    }

    // Heading
    ssd1306_draw_string(&m_display, 0, 0, 1, descriptor_it->second.name.c_str());

    // Current Selection
    std::string selection;
    switch (descriptor_it->second.type) {
    case Utils::Menu::Descriptor::Type::Root:
    case Utils::Menu::Descriptor::Type::Selection:
    case Utils::Menu::Descriptor::Type::RebootInfo:
        selection = descriptor_it->second.items.at(m_menu_state.selection).first;
        break;
    case Utils::Menu::Descriptor::Type::Value:
        selection = std::to_string(m_menu_state.selection);
        break;
    }
    ssd1306_draw_string(&m_display, (127 - (selection.length() * 12)) / 2, 15, 2, selection.c_str());

    // Breadcrumbs
    switch (descriptor_it->second.type) {
    case Utils::Menu::Descriptor::Type::Root:
    case Utils::Menu::Descriptor::Type::Selection: {
        auto selection_count = descriptor_it->second.items.size();
        for (uint8_t i = 0; i < selection_count; ++i) {
            if (i == m_menu_state.selection) {
                ssd1306_draw_square(&m_display, ((127) - ((selection_count - i) * 6)) - 1, 2, 4, 4);
            } else {
                ssd1306_draw_square(&m_display, (127) - ((selection_count - i) * 6), 3, 2, 2);
            }
        }
    } break;
    case Utils::Menu::Descriptor::Type::RebootInfo:
        break;
    case Utils::Menu::Descriptor::Type::Value:
        break;
    }
}

void Display::update() {
    static const uint32_t interval_ms = 20; // Limit to ~50fps
    static uint32_t start_ms = 0;

    if (to_ms_since_boot(get_absolute_time()) - start_ms < interval_ms) {
        return;
    }
    start_ms += interval_ms;

    ssd1306_clear(&m_display);

    switch (m_state) {
    case State::Idle:
        drawIdleScreen();
        break;
    case State::Menu:
        drawMenuScreen();
        break;
    }

    ssd1306_show(&m_display);
};

} // namespace Divacon::Peripherals